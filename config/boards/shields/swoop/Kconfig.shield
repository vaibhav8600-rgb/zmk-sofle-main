## config/boards/shields/swoop/Kconfig.shield
```kconfig
# Copyright (c) 2022 Duccio Breschi
# SPDX-License-Identifier: MIT

config SHIELD_CENTRAL_DONGLE
    def_bool $(shields_list_contains,central_dongle)

config SHIELD_SOFLE_LEFT
    def_bool $(shields_list_contains,sofle_left)

config SHIELD_SOFLE_RIGHT
    def_bool $(shields_list_contains,sofle_right)
```
